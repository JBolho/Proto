/*---------------------------------------------------------------------------
 * This file is autogenerated file using huawei LCD parser. Please do not edit it.
 * Update input XML file to add a new entry or update variable in this file
 * Parser location: vendor/huawei/chipset_common/devkit/lcdkit/tools 
 *---------------------------------------------------------------------------*/


/include/ "bach2_boe_nt51021h_10p1_1200p_video.dtsi"
/include/ "bach2_inx_nt51021h_10p1_1200p_video.dtsi"