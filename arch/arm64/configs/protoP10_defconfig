## drivers/char/acm/Kconfig
```kconfig
menu "Access Control Module"

config ACM
    bool "Enable Access Control Module"
    default n
    ---help---
        Access Control Module device driver

config ACM_DSM
	bool "Enable ACM dsm features"
	depends on HUAWEI_DSM && ACM
	default n
	---help---
		Enable dsm features for ACM

config ACM_TEST
    bool "Enable ACM debugfs features"
    depends on ACM
    default n
    ---help---
        Enable debufs features for ACM

config ACM_DEBUG
	bool "Enable debug info print"
	depends on ACM
	default n
	---help---
		Enable debug info print for ACM
endmenu
```

## drivers/huawei_platform/sw/Kconfig
```kconfig
config HW_SW_DEVICES
    boolean "single-wire communicate Keyboard with UART in inputhub for CMR Product."
    default n
    help
	  This module adds support for single-wire communicate Keyboard for CMR Product based on
	  HISI 960 chipset.
```
